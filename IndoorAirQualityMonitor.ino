//Indoor Air Quality Monitor
//The DIY Life by Michael Klements
//24 February 2022

#include <Arduino.h>                                                //Import the required libraries
#include <PromLokiTransport.h>
#include <PrometheusArduino.h>
#include <Wire.h>
#include <Adafruit_Sensor.h>
#include <Adafruit_BME280.h>
#include <Adafruit_GFX.h>
#include <Adafruit_SSD1306.h>

#include "certificates.h"
#include "config.h"

#define SCREEN_WIDTH 128                                            // OLED display width, in pixels
#define SCREEN_HEIGHT 64                                            // OLED display height, in pixels

#define OLED_RESET -1                                                           // Reset pin # (or -1 if sharing Arduino reset pin)
Adafruit_SSD1306 display(SCREEN_WIDTH, SCREEN_HEIGHT, &Wire, OLED_RESET);       // Declaration for an SSD1306 display connected to I2C (SDA, SCL pins)

// 'Air Quality', 128x64px
const unsigned char splash [] PROGMEM = {
  0x00, 0x00, 0x00, 0x00, 0x00, 0x00, 0x00, 0x00, 0x00, 0x00, 0x00, 0x00, 0x00, 0x00, 0x00, 0x00, 
  0x00, 0x00, 0x00, 0x00, 0x00, 0x00, 0x00, 0x00, 0x00, 0x00, 0x00, 0x00, 0x00, 0x00, 0x00, 0x00, 
  0x00, 0x00, 0x00, 0x00, 0x00, 0x00, 0x00, 0x00, 0x00, 0x00, 0x00, 0x00, 0x00, 0x00, 0x00, 0x00, 
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  0x00, 0x00, 0x00, 0x00, 0x00, 0x00, 0x00, 0x00, 0x00, 0x00, 0x00, 0x00, 0x00, 0x00, 0x00, 0x00
};

int CO2Sensor = 36;                                                 //Define pin numbers

Adafruit_BME280 bme;                                                //I2C

PromLokiTransport transport;                                        //Prometheus client and transport
PromClient client(transport);

WriteRequest req(4, 1537);                                          //Create a write request for 4 series

TimeSeries ts1(5, "temperature_celsius", "{monitoring_type=\"air_quality\",board_type=\"firebeetle\",room=\"lounge\"}");       //Define a TimeSeries which can hold up to 5 samples, has a name of `temperature/humidity/...` and uses the above labels of which there are 2
TimeSeries ts2(5, "humidity_percent",  "{monitoring_type=\"air_quality\",board_type=\"firebeetle\",room=\"lounge\"}");
TimeSeries ts3(5, "pressure_hectopascals",  "{monitoring_type=\"air_quality\",board_type=\"firebeetle\",room=\"lounge\"}");
TimeSeries ts4(5, "co2_ppm",  "{monitoring_type=\"air_quality\",board_type=\"firebeetle\",room=\"bedroom\"}");

int temp = 0;                                                       //Variables to store sensor readings
int humid = 0;
int pressure = 0;
int CO2 = 0;

void setupClient()                                                  //Function to set up Prometheus client
{
  Serial.println("Setting up client...");
  
  uint8_t serialTimeout;
  while (!Serial && serialTimeout < 50) 
  {
    delay(100);
    serialTimeout++;
  }
  
  transport.setUseTls(true);                                         //Configure and start the transport layer
  transport.setCerts(grafanaCert, strlen(grafanaCert));
  transport.setWifiSsid(WIFI_SSID);
  transport.setWifiPass(WIFI_PASSWORD);
  transport.setDebug(Serial);                                        //Remove this line to disable debug logging of the client.
  if (!transport.begin()) 
  {
      Serial.println(transport.errmsg);
      while (true) {};
  }

  client.setUrl(GC_PROM_URL);                                        //Configure the client
  client.setPath(GC_PROM_PATH);
  client.setPort(GC_PORT);
  client.setUser(GC_PROM_USER);
  client.setPass(GC_PROM_PASS);
  client.setDebug(Serial);                                           //Remove this line to disable debug logging of the client.
  if (!client.begin()) 
  {
      Serial.println(client.errmsg);
      while (true) {};
  }

  req.addTimeSeries(ts1);                                            //Add our TimeSeries to the WriteRequest
  req.addTimeSeries(ts2);
  req.addTimeSeries(ts3);
  req.addTimeSeries(ts4);
  req.setDebug(Serial);                                              // Remove this line to disable debug logging of the write request serialization and compression.
}

void setup()                                                         //Setup function - only function that is run in deep sleep mode
{
  Serial.begin(115200);                                              //Start the serial output at 115,200 baud
  analogReadResolution(10);                                          //Set the resolution of the analogue input
  if(!display.begin(SSD1306_SWITCHCAPVCC, 0x3C))                     //Connect to the OLED display
  {
    Serial.println(F("SSD1306 allocation failed"));                  //If connection fails
    for(;;);                                                         //Don't proceed, loop forever
  }
  display.clearDisplay();                                            //Clear the display
  display.setTextColor(SSD1306_WHITE);                               //Set the text colour to white
  display.drawBitmap(0, 0, splash, 128, 64, WHITE);                  //Display bitmap from array
  display.setTextSize(1);                                            //Set the text size
  display.setCursor(30,50);
  display.print(F("Air Quality"));
  display.display();
  setupClient();                                                     //Set up client
  unsigned status;
  status = bme.begin();                                              //Connect to BME sensor
  if (!status)
  {
    Serial.println("Could not find a valid BME280 sensor");
  }
  delay(2000);                                                       //Splash screen delay
}

void loop()                                                          //Loop function
{
  int64_t time;
  time = transport.getTimeMillis();
  recTemp ();                                                        //Take readings from BME sensor
  recHumid ();
  recPress ();
  recCO2 ();                                                         //Take readings from CO2 sensor
  Serial.print("Temp: ");                                            //Display readings on serial monitor
  Serial.println(temp);
  Serial.print("Humidity: ");
  Serial.println(humid);
  Serial.print("Pressure: ");
  Serial.println(pressure);
  Serial.print("CO2: ");
  if(CO2 >= 0)
  {
    Serial.println(CO2);
  }
  else
  {
    Serial.println("Preheating");
  }
  display.clearDisplay();                                            //Clear display
  display.setCursor(32,4);
  display.print(F("Air Quality"));
  display.setCursor(15,18);                                          //Set the display cursor position
  display.print(F("Temp: "));                                        //Set the display text
  display.setCursor(60,18);
  display.print(temp);
  display.print(F(" C"));
  display.setCursor(15,30);
  display.print(F("Humid: "));
  display.setCursor(60,30);
  display.print(humid);
  display.print(F(" %"));
  display.setCursor(15,42);
  display.print(F("Press: "));
  display.setCursor(60,42);
  display.print(pressure);
  display.print(F(" hPa"));
  display.setCursor(15,54);
  display.print(F("CO2: "));
  display.setCursor(60,54);
  if(CO2 >= 0)
  {
    display.print(CO2);
    display.print(F(" ppm"));
  }
  else
  {
    display.print(F("Preheating"));
  }
  display.display();                                                 //Output the display text
  if (!ts1.addSample(time, temp))                                    //Add data to samples
  {
    Serial.println(ts1.errmsg);
  }
  if (!ts2.addSample(time, humid)) 
  {
    Serial.println(ts2.errmsg);
  }
  if (!ts3.addSample(time, pressure)) 
  {
    Serial.println(ts3.errmsg);
  }
  if (!ts4.addSample(time, CO2)) 
  {
    Serial.println(ts4.errmsg);
  }
  PromClient::SendResult res = client.send(req);                     //Send data to Prometheus
  if (!res == PromClient::SendResult::SUCCESS) 
  {
    Serial.println(client.errmsg);
  }
  ts1.resetSamples();                                                //Reset batches after a succesful send.
  ts2.resetSamples();
  ts3.resetSamples();
  ts4.resetSamples();
  delay(60000);                                                      //Wait 60 seconds
}

void recTemp ()                                                      //Function to record the temperature
{
  temp = bme.readTemperature();
}

void recHumid ()                                                     //Function to record the humidity
{
  humid = bme.readHumidity();
  if (humid > 100)
    humid = 100;
}

void recPress ()                                                     //Function to record the pressure
{
  pressure = bme.readPressure()/100;
}

void recCO2 ()
{
  int sensorValue = analogRead(CO2Sensor);
  Serial.print("Sensor Reading: ");
  Serial.println(sensorValue);
  float voltage = sensorValue*(3300/1023)+154;
  Serial.print("Voltage: ");
  Serial.println(voltage);
  if (voltage < 400)
  {
    CO2 = -1;
  }
  else
  {
    CO2 = (voltage-400)*50/16;
  }
}
